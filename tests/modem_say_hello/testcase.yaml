## tests/modem_say_hello/testcase.yaml
```yaml
tests:
  my.module.under.test:
    tags: test_framework
    harness: ztest
    
    # 1. Allow QEMU
    platform_allow: 
      - qemu_cortex_m3
      
    # 2. Explicitly Ban Native (Just to be safe)
    platform_exclude: 
      - native_sim

    integration_platforms:
      - qemu_cortex_m3
```
